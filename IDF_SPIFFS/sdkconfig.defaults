## IDF_SPIFFS/sdkconfig.defaults
```kconfig
CONFIG_PARTITION_TABLE_CUSTOM=y
CONFIG_PARTITION_TABLE_CUSTOM_FILENAME="partitions_example.csv"
CONFIG_PARTITION_TABLE_FILENAME="partitions_example.csv"

CONFIG_SERVER_IP="192.168.0.3"
CONFIG_SERVER_PORT="8070"
CONFIG_EXAMPLE_FILENAME="ota.ota.bin"
```
